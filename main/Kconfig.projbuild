## main/Kconfig.projbuild
```kconfig
# put here your custom config value
menu "Role Configuration"
config ESP_BLE_ROLE
    string "ROLE"
    default 0
    help
 	Predefined Role of the node: 0 -> SERVER, 1 -> CLIENT, 2 -> RELAY, 3 -> ATTACKER
endmenu
```
